/dts-v1/;
/plugin/;
/ {
    fragment@0 {
        target-path = "/axi";
        __overlay__ {
            firmware-name = "snn_app.bit.bin";

            zyxclmm_drm {
                compatible = "xlnx,zocl";
                status = "okay";
            };
        };
    };
};
